i2c0: i2c@0 {
	status = "okay";
	compatible = "zephyr,i2c-emul-controller";
	clock-frequency = <I2C_BITRATE_STANDARD>;
	#address-cells = <1>;
	#size-cells = <0>;
	reg = <0x0 4>;
	zephyr,deferred-init;

	/* Simulated device; will talk to projects/zephyr/drivers/fuel_gauge/sbs_gauge/emul_sbs_gauge.c */
	fuel_gauge: fuel_gauge@0 {
		compatible = "sbs,sbs-gauge-new-api";
		status = "okay";
		reg = <0x0>;
		zephyr,deferred-init;
	};
};
