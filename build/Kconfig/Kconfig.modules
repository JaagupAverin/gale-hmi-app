## build/Kconfig/Kconfig.modules
```kconfig
menu "nrf (/home/jaagup/projects/gale_ws/gale/projects/nrf)"
osource "/home/jaagup/projects/gale_ws/gale/projects/nrf/Kconfig.nrf"
config ZEPHYR_NRF_MODULE
	bool
	default y
endmenu
menu "mcuboot (/home/jaagup/projects/gale_ws/gale/projects/bootloader/mcuboot)"
osource "$(ZEPHYR_MCUBOOT_KCONFIG)"
config ZEPHYR_MCUBOOT_MODULE
	bool
	default y
endmenu
menu "cmsis_6 (/home/jaagup/projects/gale_ws/gale/projects/modules/hal/cmsis_6)"
osource "$(ZEPHYR_CMSIS_6_KCONFIG)"
config ZEPHYR_CMSIS_6_MODULE
	bool
	default y
endmenu
menu "hal_nordic (/home/jaagup/projects/gale_ws/gale/projects/modules/hal/nordic)"
osource "$(ZEPHYR_HAL_NORDIC_KCONFIG)"
config ZEPHYR_HAL_NORDIC_MODULE
	bool
	default y

config ZEPHYR_HAL_NORDIC_MODULE_BLOBS
	bool
endmenu
menu "nrfxlib (/home/jaagup/projects/gale_ws/gale/projects/nrfxlib)"
osource "/home/jaagup/projects/gale_ws/gale/projects/nrfxlib/Kconfig.nrfxlib"
config ZEPHYR_NRFXLIB_MODULE
	bool
	default y
endmenu
config ZEPHYR_NRF_HW_MODELS_MODULE
	bool
	default y
```

## build/Kconfig/Kconfig.sysbuild.modules
```kconfig
menu "nrf (/home/jaagup/projects/gale_ws/gale/projects/nrf)"
osource "/home/jaagup/projects/gale_ws/gale/projects/nrf/sysbuild/Kconfig.sysbuild"
config ZEPHYR_NRF_MODULE
	bool
	default y
endmenu
config ZEPHYR_MCUBOOT_MODULE
   bool
   default y
config ZEPHYR_CMSIS_6_MODULE
   bool
   default y
config ZEPHYR_HAL_NORDIC_MODULE
   bool
   default y
config ZEPHYR_NRFXLIB_MODULE
   bool
   default y
config ZEPHYR_NRF_HW_MODELS_MODULE
   bool
   default y
```

## build/Kconfig/arch/Kconfig
```kconfig
# Load Zephyr Arch Kconfig descriptions.
osource "/home/jaagup/projects/gale_ws/gale/projects/zephyr/arch/rx/Kconfig"
osource "/home/jaagup/projects/gale_ws/gale/projects/zephyr/arch/x86/Kconfig"
osource "/home/jaagup/projects/gale_ws/gale/projects/zephyr/arch/xtensa/Kconfig"
osource "/home/jaagup/projects/gale_ws/gale/projects/zephyr/arch/sparc/Kconfig"
osource "/home/jaagup/projects/gale_ws/gale/projects/zephyr/arch/riscv/Kconfig"
osource "/home/jaagup/projects/gale_ws/gale/projects/zephyr/arch/posix/Kconfig"
osource "/home/jaagup/projects/gale_ws/gale/projects/zephyr/arch/mips/Kconfig"
osource "/home/jaagup/projects/gale_ws/gale/projects/zephyr/arch/arm64/Kconfig"
osource "/home/jaagup/projects/gale_ws/gale/projects/zephyr/arch/arm/Kconfig"
osource "/home/jaagup/projects/gale_ws/gale/projects/zephyr/arch/arc/Kconfig"
```

## build/Kconfig/boards/Kconfig.defconfig
```kconfig
# Load Zephyr board defconfig descriptions.
osource "/home/jaagup/projects/gale_ws/gale/projects/zephyr/boards/native/nrf_bsim/Kconfig.defconfig"
```

## build/hmi_app/Kconfig/Kconfig.shield
```kconfig
osource "/home/jaagup/projects/gale_ws/gale/projects/nrf/boards/shields/*/Kconfig.shield"
```

## build/hmi_app/Kconfig/boards/Kconfig.nrf54l15bsim
```kconfig
# Load board Kconfig descriptions.
osource "/home/jaagup/projects/gale_ws/gale/projects/zephyr/boards/native/nrf_bsim/Kconfig.nrf54l15bsim"
```

## build/hmi_app/Kconfig/boards/Kconfig.sysbuild
```kconfig
# Load Sysbuild board Kconfig descriptions.
osource "/home/jaagup/projects/gale_ws/gale/projects/zephyr/boards/native/nrf_bsim/Kconfig.sysbuild"
```

## build/hmi_app/Kconfig/soc/Kconfig
```kconfig
# Load Zephyr SoC Kconfig descriptions.
osource "/home/jaagup/projects/gale_ws/gale/projects/zephyr/soc/xlnx/zynqmp/Kconfig"
osource "/home/jaagup/projects/gale_ws/gale/projects/zephyr/soc/xlnx/zynq7000/Kconfig"
osource "/home/jaagup/projects/gale_ws/gale/projects/zephyr/soc/xlnx/versalnet/Kconfig"
osource "/home/jaagup/projects/gale_ws/gale/projects/zephyr/soc/xen/Kconfig"
osource "/home/jaagup/projects/gale_ws/gale/projects/zephyr/soc/wch/ch32v/Kconfig"
osource "/home/jaagup/projects/gale_ws/gale/projects/zephyr/soc/ti/simplelink/Kconfig"
osource "/home/jaagup/projects/gale_ws/gale/projects/zephyr/soc/ti/lm3s6965/Kconfig"
osource "/home/jaagup/projects/gale_ws/gale/projects/zephyr/soc/ti/k3/Kconfig"
osource "/home/jaagup/projects/gale_ws/gale/projects/zephyr/soc/telink/tlsr/Kconfig"
osource "/home/jaagup/projects/gale_ws/gale/projects/zephyr/soc/starfive/jh71xx/Kconfig"
osource "/home/jaagup/projects/gale_ws/gale/projects/zephyr/soc/st/stm32/Kconfig"
osource "/home/jaagup/projects/gale_ws/gale/projects/zephyr/soc/snps/qemu_arc/Kconfig"
osource "/home/jaagup/projects/gale_ws/gale/projects/zephyr/soc/snps/nsim/arc_v/Kconfig"
osource "/home/jaagup/projects/gale_ws/gale/projects/zephyr/soc/snps/nsim/arc_classic/Kconfig"
osource "/home/jaagup/projects/gale_ws/gale/projects/zephyr/soc/snps/hsdk4xd/Kconfig"
osource "/home/jaagup/projects/gale_ws/gale/projects/zephyr/soc/snps/hsdk/Kconfig"
osource "/home/jaagup/projects/gale_ws/gale/projects/zephyr/soc/snps/emsk/Kconfig"
osource "/home/jaagup/projects/gale_ws/gale/projects/zephyr/soc/snps/emsdp/Kconfig"
osource "/home/jaagup/projects/gale_ws/gale/projects/zephyr/soc/snps/arc_iot/Kconfig"
osource "/home/jaagup/projects/gale_ws/gale/projects/zephyr/soc/silabs/Kconfig"
osource "/home/jaagup/projects/gale_ws/gale/projects/zephyr/soc/sifive/sifive_freedom/Kconfig"
osource "/home/jaagup/projects/gale_ws/gale/projects/zephyr/soc/sensry/Kconfig"
osource "/home/jaagup/projects/gale_ws/gale/projects/zephyr/soc/rockchip/Kconfig"
osource "/home/jaagup/projects/gale_ws/gale/projects/zephyr/soc/renode/riscv_virtual/Kconfig"
osource "/home/jaagup/projects/gale_ws/gale/projects/zephyr/soc/renode/cortex_r8_virtual/Kconfig"
osource "/home/jaagup/projects/gale_ws/gale/projects/zephyr/soc/renesas/smartbond/Kconfig"
osource "/home/jaagup/projects/gale_ws/gale/projects/zephyr/soc/renesas/rz/Kconfig"
osource "/home/jaagup/projects/gale_ws/gale/projects/zephyr/soc/renesas/rcar/Kconfig"
osource "/home/jaagup/projects/gale_ws/gale/projects/zephyr/soc/renesas/ra/Kconfig"
osource "/home/jaagup/projects/gale_ws/gale/projects/zephyr/soc/realtek/ec/Kconfig"
osource "/home/jaagup/projects/gale_ws/gale/projects/zephyr/soc/raspberrypi/rpi_pico/Kconfig"
osource "/home/jaagup/projects/gale_ws/gale/projects/zephyr/soc/quicklogic/eos_s3/Kconfig"
osource "/home/jaagup/projects/gale_ws/gale/projects/zephyr/soc/qemu/virt_riscv/Kconfig"
osource "/home/jaagup/projects/gale_ws/gale/projects/zephyr/soc/qemu/malta/Kconfig"
osource "/home/jaagup/projects/gale_ws/gale/projects/zephyr/soc/openisa/rv32m1/Kconfig"
osource "/home/jaagup/projects/gale_ws/gale/projects/zephyr/soc/openhwgroup/cva6/Kconfig"
osource "/home/jaagup/projects/gale_ws/gale/projects/zephyr/soc/oct/osd32mp15x/Kconfig"
osource "/home/jaagup/projects/gale_ws/gale/projects/zephyr/soc/nxp/s32/Kconfig"
osource "/home/jaagup/projects/gale_ws/gale/projects/zephyr/soc/nxp/rw/Kconfig"
osource "/home/jaagup/projects/gale_ws/gale/projects/zephyr/soc/nxp/mcx/Kconfig"
osource "/home/jaagup/projects/gale_ws/gale/projects/zephyr/soc/nxp/lpc/Kconfig"
osource "/home/jaagup/projects/gale_ws/gale/projects/zephyr/soc/nxp/layerscape/Kconfig"
osource "/home/jaagup/projects/gale_ws/gale/projects/zephyr/soc/nxp/kinetis/Kconfig"
osource "/home/jaagup/projects/gale_ws/gale/projects/zephyr/soc/nxp/imxrt/Kconfig"
osource "/home/jaagup/projects/gale_ws/gale/projects/zephyr/soc/nxp/imx/Kconfig"
osource "/home/jaagup/projects/gale_ws/gale/projects/zephyr/soc/nuvoton/numicro/Kconfig"
osource "/home/jaagup/projects/gale_ws/gale/projects/zephyr/soc/nuvoton/numaker/Kconfig"
osource "/home/jaagup/projects/gale_ws/gale/projects/zephyr/soc/nuvoton/npcx/Kconfig"
osource "/home/jaagup/projects/gale_ws/gale/projects/zephyr/soc/nuvoton/npcm/Kconfig"
osource "/home/jaagup/projects/gale_ws/gale/projects/zephyr/soc/nordic/Kconfig"
osource "/home/jaagup/projects/gale_ws/gale/projects/zephyr/soc/neorv32/Kconfig"
osource "/home/jaagup/projects/gale_ws/gale/projects/zephyr/soc/native/inf_clock/Kconfig"
osource "/home/jaagup/projects/gale_ws/gale/projects/zephyr/soc/microchip/miv/Kconfig"
osource "/home/jaagup/projects/gale_ws/gale/projects/zephyr/soc/microchip/mec/Kconfig"
osource "/home/jaagup/projects/gale_ws/gale/projects/zephyr/soc/mediatek/mt8xxx/Kconfig"
osource "/home/jaagup/projects/gale_ws/gale/projects/zephyr/soc/lowrisc/opentitan/Kconfig"
osource "/home/jaagup/projects/gale_ws/gale/projects/zephyr/soc/litex/litex_vexriscv/Kconfig"
osource "/home/jaagup/projects/gale_ws/gale/projects/zephyr/soc/ite/ec/Kconfig"
osource "/home/jaagup/projects/gale_ws/gale/projects/zephyr/soc/intel/raptor_lake/Kconfig"
osource "/home/jaagup/projects/gale_ws/gale/projects/zephyr/soc/intel/lakemont/Kconfig"
osource "/home/jaagup/projects/gale_ws/gale/projects/zephyr/soc/intel/intel_socfpga_std/Kconfig"
osource "/home/jaagup/projects/gale_ws/gale/projects/zephyr/soc/intel/intel_socfpga/Kconfig"
osource "/home/jaagup/projects/gale_ws/gale/projects/zephyr/soc/intel/intel_niosv/Kconfig"
osource "/home/jaagup/projects/gale_ws/gale/projects/zephyr/soc/intel/intel_ish/Kconfig"
osource "/home/jaagup/projects/gale_ws/gale/projects/zephyr/soc/intel/intel_adsp/Kconfig"
osource "/home/jaagup/projects/gale_ws/gale/projects/zephyr/soc/intel/elkhart_lake/Kconfig"
osource "/home/jaagup/projects/gale_ws/gale/projects/zephyr/soc/intel/atom/Kconfig"
osource "/home/jaagup/projects/gale_ws/gale/projects/zephyr/soc/intel/apollo_lake/Kconfig"
osource "/home/jaagup/projects/gale_ws/gale/projects/zephyr/soc/intel/alder_lake/Kconfig"
osource "/home/jaagup/projects/gale_ws/gale/projects/zephyr/soc/infineon/cat3/Kconfig"
osource "/home/jaagup/projects/gale_ws/gale/projects/zephyr/soc/infineon/cat1b/Kconfig"
osource "/home/jaagup/projects/gale_ws/gale/projects/zephyr/soc/infineon/cat1a/Kconfig"
osource "/home/jaagup/projects/gale_ws/gale/projects/zephyr/soc/gd/gd32/Kconfig"
osource "/home/jaagup/projects/gale_ws/gale/projects/zephyr/soc/gaisler/leon3/Kconfig"
osource "/home/jaagup/projects/gale_ws/gale/projects/zephyr/soc/gaisler/gr716a/Kconfig"
osource "/home/jaagup/projects/gale_ws/gale/projects/zephyr/soc/espressif/Kconfig"
osource "/home/jaagup/projects/gale_ws/gale/projects/zephyr/soc/ene/kb1200/Kconfig"
osource "/home/jaagup/projects/gale_ws/gale/projects/zephyr/soc/efinix/sapphire/Kconfig"
osource "/home/jaagup/projects/gale_ws/gale/projects/zephyr/soc/cdns/xtensa_sample_controller/Kconfig"
osource "/home/jaagup/projects/gale_ws/gale/projects/zephyr/soc/cdns/sample_controller32/Kconfig"
osource "/home/jaagup/projects/gale_ws/gale/projects/zephyr/soc/cdns/dc233c/Kconfig"
osource "/home/jaagup/projects/gale_ws/gale/projects/zephyr/soc/brcm/bcmvk/Kconfig"
osource "/home/jaagup/projects/gale_ws/gale/projects/zephyr/soc/brcm/bcm2712/Kconfig"
osource "/home/jaagup/projects/gale_ws/gale/projects/zephyr/soc/brcm/bcm2711/Kconfig"
osource "/home/jaagup/projects/gale_ws/gale/projects/zephyr/soc/bouffalolab/Kconfig"
osource "/home/jaagup/projects/gale_ws/gale/projects/zephyr/soc/atmel/sam0/Kconfig"
osource "/home/jaagup/projects/gale_ws/gale/projects/zephyr/soc/atmel/sam/Kconfig"
osource "/home/jaagup/projects/gale_ws/gale/projects/zephyr/soc/aspeed/Kconfig"
osource "/home/jaagup/projects/gale_ws/gale/projects/zephyr/soc/arm/Kconfig"
osource "/home/jaagup/projects/gale_ws/gale/projects/zephyr/soc/arm/beetle/Kconfig"
osource "/home/jaagup/projects/gale_ws/gale/projects/zephyr/soc/antmicro/myra/Kconfig"
osource "/home/jaagup/projects/gale_ws/gale/projects/zephyr/soc/andestech/Kconfig"
osource "/home/jaagup/projects/gale_ws/gale/projects/zephyr/soc/amd/acp_6_0/Kconfig"
osource "/home/jaagup/projects/gale_ws/gale/projects/zephyr/soc/ambiq/Kconfig"
osource "/home/jaagup/projects/gale_ws/gale/projects/zephyr/soc/altr/zephyr_nios2f/Kconfig"
osource "/home/jaagup/projects/gale_ws/gale/projects/zephyr/soc/altr/qemu_nios2/Kconfig"
osource "/home/jaagup/projects/gale_ws/gale/projects/zephyr/soc/adi/max32/Kconfig"
osource "/home/jaagup/projects/gale_ws/gale/projects/nrf/soc/nordic/Kconfig"
```
